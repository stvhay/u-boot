/*
 * (C) Copyright 2021 Rockchip Electronics Co., Ltd
 *
 * SPDX-License-Identifier:     GPL-2.0+
 */

#include "rk3588s-u-boot.dtsi"

&pcie30_phy_grf {
	u-boot,dm-pre-reloc;
	status = "okay";
};

&pipe_phy1_grf {
	u-boot,dm-pre-reloc;
	status = "okay";
};